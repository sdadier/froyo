## Kernel/Kernel/sound/soc/codecs/Kconfig.voodoo.rej
```kconfig
--- Kernel/sound/soc/codecs/Kconfig.voodoo
+++ Kernel/sound/soc/codecs/Kconfig.voodoo
@@ -1,4 +1,4 @@
-config SND_VOODOO
+menuconfig SND_VOODOO
 	bool "Voodoo sound driver"
 	depends on SND_S3C24XX_SOC
 	default y
@@ -23,6 +23,18 @@
 	  Default headphone amplifier level. Take care not setting it to high,
 	  it would introduce hiss for people not using the control app
 
+config SND_VOODOO_RECORD_PRESETS
+	bool "Microphone recording presets"
+	depends on SND_VOODOO
+	default y
+	help
+	  Recording presets with Dynamic Range Compression auto-gain
+	  on microphone:
+	    - Original
+	    - High sensitivity
+	    - Balanced (recommanded, default)
+	    - Loud environment - concert
+
 config SND_VOODOO_FM
 	bool "FM radio: restore a normal frequency response"
 	depends on SND_VOODOO && SND_ARIES_SOC_WM8994
@@ -35,4 +47,12 @@
 	depends on SND_VOODOO && SND_ARIES_SOC_WM8994
 	default n
 	help
+	  Allow to codec dump registers and load register-address/value batchs
+	  Powerful but also dangerous tool
+
+config SND_VOODOO_DEBUG_LOG
+	bool "Log every wm8994_write"
+	depends on SND_VOODOO_DEBUG
+	default n
+	help
 	  Log codec writes
```
